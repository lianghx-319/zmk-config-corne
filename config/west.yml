## config/west.yml
```yaml
manifest:
  remotes:
    - name: zmkfirmware
      url-base: https://github.com/zmkfirmware
    - name: ftc
      url-base: https://github.com/ftc
    - name: petejohanson
      url-base: https://github.com/petejohanson
    - name: caksoylar
      url-base: https://github.com/caksoylar
  projects:
    - name: zmk
      remote: caksoylar
      revision: mods-widget
      import: app/west.yml
#   - name: zmk
#      remote: ftc
#      revision: mouse-ftc
#      import: app/west.ym

  self:
    path: config
```
